#include "TinyFont.h"
#include <pgmspace.h> // Required for Flash memory reading macros

// Micro 4x5 Font definition lookup tables - Moved entirely to Flash memory (PROGMEM)
const TFFace tinyFont[] PROGMEM = {
  { {0b00000000, 0b00000000, 0b00000000, 0b00000000, 0b00000000} }, // space
  { {0b00001000, 0b00001000, 0b00001000, 0b00000000, 0b00001000} }, // !
  { {0b00001010, 0b00001010, 0b00000000, 0b00000000, 0b00000000} }, // "
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  { {0b00000110, 0b00001111, 0b00001111, 0b000001110, 0b00001000} }  // i
};

const int cfblack = 0;
static const char single_col_chars[] = " !.|1:";

void TFDrawChar(PxMATRIX* d, char value, char xo, char yo, int col) {
  int cfi = value - ' ';
  if (cfi < 0 || cfi >= (int)(sizeof(tinyFont) / sizeof(TFFace))) {
    Serial.print("Character code not supported: ");
    Serial.println((int)value);
    return;
  }

  int s = strchr(single_col_chars, value) ? 1 : 0;

  for (int i = 0; i < TF_ROWS; i++) {
    int max_cols = (s == 1) ? 3 : TF_COLS;
    
    // Read the row byte directly from Flash Memory space
    char rowData = pgm_read_byte(&(tinyFont[cfi].fface[i]));

    for (int j = s; j < max_cols; j++) {
      if (rowData & (1 << j)) {
        d->drawPixel(xo + TF_COLS - j - s, yo + i, col);
      } else {
        d->drawPixel(xo + TF_COLS - j - s, yo + i, cfblack);
      }
    }
  }
}

void TFDrawText(PxMATRIX* d, const String& text, char xo, char yo, int col) {
  unsigned char pixels = 0;
  unsigned char lpbuf[34]; // Added safety overflow room
  bool loop = true;
  unsigned int i = 0;

  for (i = 0; i < text.length() && loop; i++) {
    char s = (strchr(single_col_chars, text[i])) ? 2 : TF_COLS;
    if ((pixels + s) > 64) {
      loop = false;
      i--; 
    } else {
      pixels += s;
    }
  }

  text.getBytes(lpbuf, i + 1);
  unsigned char* lptr = lpbuf;

  while (*lptr) {
    bool sc = strchr(single_col_chars, *lptr) != nullptr;
    TFDrawChar(d, *lptr, xo, yo, col);
    xo += (sc ? 2 : TF_COLS);
    lptr++;
  }
}